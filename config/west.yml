## config/west.yml
```yaml
manifest:
  remotes:
    - name: zmkfirmware
      url-base: https://github.com/zmkfirmware
    - name: tominabox1
      url-base: https://github.com/tominabox1/
    - name: nicell
      url-base: https://github.com/Nicell/
    - name: okke
      url-base: https://github.com/okke-formsma
    - name: pete
      url-base: https://github.com/petejohanson/
  projects:
    - name: zmk
      remote: pete
      revision: zephyr-2.5-upgrade
      import: app/west.yml
  self:
    path: config
```
